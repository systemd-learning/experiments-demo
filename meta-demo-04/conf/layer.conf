## meta-demo-04/conf/layer.conf
```bitbake
# We have a conf and classes directory, add to BBPATH
BBPATH .= ":${LAYERDIR}"

# We have recipes-* directories, add to BBFILES
BBFILES += "${LAYERDIR}/recipes-*/*/*.bb \
            ${LAYERDIR}/recipes-*/*/*.bbappend"

BBFILE_COLLECTIONS += "meta-demo-04"
BBFILE_PATTERN_meta-demo-04 = "^${LAYERDIR}/"
BBFILE_PRIORITY_meta-demo-04 = "6"

LAYERDEPENDS_meta-demo-04 = "core"
LAYERSERIES_COMPAT_meta-demo-04 = "honister mickledore"
```

## meta-demo-05/conf/layer.conf
```bitbake
# We have a conf and classes directory, add to BBPATH
BBPATH .= ":${LAYERDIR}"

# We have recipes-* directories, add to BBFILES
BBFILES += "${LAYERDIR}/recipes-*/*/*.bb \
            ${LAYERDIR}/recipes-*/*/*.bbappend"

BBFILE_COLLECTIONS += "meta-demo-05"
BBFILE_PATTERN_meta-demo-05 = "^${LAYERDIR}/"
BBFILE_PRIORITY_meta-demo-05 = "6"

LAYERDEPENDS_meta-meta-demo-05 = "core"
LAYERSERIES_COMPAT_meta-demo-05 = "honister"
```
